## config/boards/shields/tracktyl56/Kconfig.defconfig
```kconfig
if SHIELD_TRACKTYL_MANUFORM_5x6_LEFT

    config ZMK_KEYBOARD_NAME
        default "tracktyl56_left"

    config ZMK_SPLIT_ROLE_CENTRAL
        default y

    config ZMK_POINTING
    default y

    config SPI
    default y

endif

if SHIELD_TRACKTYL_MANUFORM_5x6_RIGHT

    config ZMK_KEYBOARD_NAME
        default "tracktyl56_right"

endif

if SHIELD_TRACKTYL_MANUFORM_5x6_LEFT || SHIELD_TRACKTYL_MANUFORM_5x6_RIGHT

    config ZMK_SPLIT
        default y

endif
```

## config/boards/shields/tracktyl56/Kconfig.shield
```kconfig
config SHIELD_TRACKTYL_MANUFORM_5x6_LEFT
    def_bool $(shields_list_contains,tracktyl56_left)

config SHIELD_TRACKTYL_MANUFORM_5x6_RIGHT
    def_bool $(shields_list_contains,tracktyl56_right)
```

## config/boards/shields/tracktyl_manuform_5x6/Kconfig.defconfig
```kconfig
if SHIELD_TRACKTYL_MANUFORM_5x6_LEFT

    config ZMK_KEYBOARD_NAME
        default "TM-5x6(Left)"

    config ZMK_SPLIT_BLE_ROLE_CENTRAL
        default y

endif

if SHIELD_TRACKTYL_MANUFORM_5x6_RIGHT

    config ZMK_KEYBOARD_NAME
        default "TM-5x6(Right)"

endif

if SHIELD_TRACKTYL_MANUFORM_5x6_LEFT || SHIELD_TRACKTYL_MANUFORM_5x6_RIGHT

    config ZMK_SPLIT
        default y

endif
```

## config/boards/shields/tracktyl_manuform_5x6/Kconfig.shield
```kconfig
config SHIELD_TRACKTYL_MANUFORM_5x6_LEFT
    def_bool $(shields_list_contains,tracktyl_manuform_5x6_left)

config SHIELD_TRACKTYL_MANUFORM_5x6_RIGHT
    def_bool $(shields_list_contains,tracktyl_manuform_5x6_right)
```

## config/west.yml
```yaml
manifest:
  remotes:
    - name: zmkfirmware
      url-base: https://github.com/Luberry
  projects:
    - name: zmk
      remote: zmkfirmware
      revision: pmw3389
      import: app/west.yml
  self:
    path: config
```
